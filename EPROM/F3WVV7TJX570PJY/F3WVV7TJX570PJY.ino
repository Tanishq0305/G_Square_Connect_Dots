#include <Wire.h>

const int writeBTN = 9;
const int readBTN = 8;

const int debounceDelay = 50; // 50 ms delay to wait until stable read

const byte EEPROM_ADDR = 0x50; // I2C address for 24LC128 EEPROM

// Parsed HEX file data (first 256 bytes)
const byte hexData[] = {
  0x0C, 0x94, 0x62, 0x00, 0x0C, 0x94, 0x8A, 0x00, 0x0C, 0x94, 0x8A, 0x00, 0x0C, 0x94, 0x8A, 0x00,
  0x0C, 0x94, 0x8A, 0x00, 0x0C, 0x94, 0x8A, 0x00, 0x0C, 0x94, 0x8A, 0x00, 0x0C, 0x94, 0x8A, 0x00,
  0x0C, 0x94, 0x8A, 0x00, 0x0C, 0x94, 0x8A, 0x00, 0x0C, 0x94, 0x8A, 0x00, 0x0C, 0x94, 0x8A, 0x00,
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  0xC0, 0x80, 0x91, 0x80, 0x00
};

char MEM[320];

void setup() {
  Serial.begin(9600);
  Wire.begin();

  pinMode(writeBTN, INPUT_PULLUP);
  pinMode(readBTN, INPUT_PULLUP);
}

void loop() {

  if (!debounce(writeBTN)) {
    Serial.println();
    Serial.println("Writing to Ext.EEPROM...");

    for (unsigned int i = 0; i < sizeof(hexData); i++) {
      writeEEPROM(i, hexData[i]);
    }
    Serial.println("Write Complete");
  }

  if (!debounce(readBTN)) {
    Serial.println();
    Serial.println("Reading Ext.EEPROM...");
    for (unsigned int j = 0; j < sizeof(MEM); j++) {
      MEM[j] = readEEPROM(j);
    }
    Serial.println("Read Complete");
    Serial.println("EEPROM Content:");
    for (unsigned int k = 0; k < sizeof(MEM); k++) {
      Serial.print(MEM[k], HEX);
      Serial.print(" ");
    }
    Serial.println();
  }
}

void writeEEPROM(unsigned int address, byte data) {
  Wire.beginTransmission(EEPROM_ADDR);
  Wire.write((int)highByte(address));
  Wire.write((int)lowByte(address));
  Wire.write(data);
  Wire.endTransmission();
  delay(5); // wait to complete the write cycle
}

byte readEEPROM(unsigned int address) {
  byte data;
  Wire.beginTransmission(EEPROM_ADDR);
  Wire.write((int)highByte(address));
  Wire.write((int)lowByte(address));
  Wire.endTransmission();
  Wire.requestFrom(EEPROM_ADDR, (byte)1);
  while (Wire.available() == 0);  // wait for data
  data = Wire.read();
  return data;
}

boolean debounce(int pin) {
  boolean state;
  boolean previousState;
  previousState = digitalRead(pin); // store switch state

  for (int counter = 0; counter < debounceDelay; counter++) {
    delay(5); // wait for 5 ms
    state = digitalRead(pin); // read the pin
    if (state != previousState) {
      counter = 0; // reset the counter if the state changes
      previousState = state; // save the current state
    }
  }

  return state; // now return the stable state
}
